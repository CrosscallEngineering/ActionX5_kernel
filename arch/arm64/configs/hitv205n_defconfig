## drivers/soc/hisense/pmic/Kconfig
```kconfig
config HISENSE_CHARGE_FG_FUNCTION
	bool "Add the hisense charge/fg driver"
	depends on MACH_HISENSE_SMARTPHONE
	default n
	help
	  Add the hisense charge function.Such as smb-charger,fg and so on.

config HISENSE_CHARGE_PARALLEL_FUNCTION
	bool "Add the hisense parallel feature"
	depends on MACH_HISENSE_SMARTPHONE
	default n
	help
	  Add the hisense parallel charge function.

config HISENSE_WEAK_CHARGER
	bool "Add the WEAK charger or line support"
	depends on HISENSE_CHARGE_FG_FUNCTION
	default n
	help
	  Add weak charger or line support.

config COMP_MULTI_PROFILE
	bool "multi profile load depend on batt_id"
	depends on OF_BATTERYDATA && MACH_HISENSE_SMARTPHONE
	default n
	help
	 y to use batt id select battery profile.
	 n not using batt id select battery profile.

config HISENSE_TYPEC_OTG_CONTROL_FUNCTION
	bool "type c OTG control"
	depends on MACH_HISENSE_SMARTPHONE
	default n
	help
	 y to use type c OTG control.
	 n not using type c OTG control.

config HISENSE_BATTERY_THERM_NTC_10K
	bool "using battery thermal 10k ntc"
	depends on MACH_HISENSE_SMARTPHONE
	default n
	help
	 y to use 10k ntc.
	 n to use default 100k ntc.

config HISENSE_GPIO_TRIG_OTG
	bool "use gpio trigger otg mode"
	depends on MACH_HISENSE_SMARTPHONE
	default n
	help
	 y to use gpio trigger otg mode.
	 n not using gpio to trigger otg.

config HISENSE_TYPEC_POGO_PEN
	bool "use pogo pen feature ode"
	depends on MACH_HISENSE_SMARTPHONE
	default n
	help
	 y to use pogo pen feature
	 n not using pogo pen/gpio to trigger otg.

config HISENSE_UKL_SAFE_MODE_FUNCTION
	bool "use safe mode(long charge mode)"
	depends on MACH_HISENSE_SMARTPHONE
	default n
	help
	 y to use safe mode feature
	 n not using safe (long) charge mode.
```

## drivers/soc/hisense/usb/Kconfig
```kconfig
config HISENSE_ADB_BACKDOOR_CHANGE
	bool "HISENSE_ADB_BACKDOOR_FEATURE"
	depends on HISENSE_ADB_BACKDOOR
	default n
	help
	  Implement Change Hisense USB adb backdoor feature.

config HISENSE_GPIO_TRIG_EXT_CHG
        bool "use gpio trig ext chg"
        depends on MACH_HISENSE_SMARTPHONE
        default n
        help
          Say Y to include support gpio trig ext chg feature.
          The N  is disable ext chg feature. driver supports.
```

## fs/sdcardfs/Kconfig
```kconfig
config SDCARD_FS
	tristate "sdcard file system"
	depends on CONFIGFS_FS
	default n
	help
	  Sdcardfs is based on Wrapfs file system.

config SDCARD_FS_FADV_NOACTIVE
	bool "sdcardfs fadvise noactive support"
	depends on FADV_NOACTIVE
	default y
	help
	  Sdcardfs supports fadvise noactive mode.

config MULTI_USER_ID
	bool "resolve permission between multi user id"
	depends on SDCARD_FS
	default y
	help
	  Sdcardfs supports multi user can read/write same files and dirs.

config SDCARD_FS_BYPASS_PERM_CHECK
	bool "allow specail apps to bypass permission-check to access to sdcardfs"
	depends on SDCARD_FS
	default y
	help
	  Sdcardfs supports bypass permission-check to access to sdcard.
```
