## arch/arm64/configs/hitv205n_defconfig
```kconfig
#
# Hisense product Infomation
#
CONFIG_HISENSE_VENDOR_NAME="Hisense"
CONFIG_HISENSE_PRODUCT_NAME="hitv205n"
CONFIG_PROJECTNAME_REPORT=y
CONFIG_SENSORS=y
CONFIG_SENSORS_SSC=y
#
# Hisense sensors device support
#
CONFIG_HS_SNS_ACC=y
CONFIG_HS_SNS_ADSP_ACC=y
CONFIG_HS_SNS_STEP=y
CONFIG_ACC_SENSOR_VENDOR="STK"
CONFIG_ACC_SENSOR_TYPE="STK8XXX"
# CONFIG_HS_SNS_MAG is not set
# CONFIG_HS_SNS_ADSP_MAG is not set
# CONFIG_HS_SNS_GYRO is not set
# CONFIG_HS_SNS_ADSP_GYRO is not set
CONFIG_HS_SNS_ALS=y
CONFIG_HS_SNS_ADSP_ALSPS=y
CONFIG_ALSP_SENSOR_TYPE="STK"
CONFIG_ALSP_SENSOR_VENDOR="STK3B6X"
#
# Hisense fuse support
#
CONFIG_QCOM_CHIP_EFUSE=y
#
# Hisense charge device support
#
CONFIG_HISENSE_BATTERY_THERM_NTC_10K=y
CONFIG_SMB1355_SLAVE_CHARGER=y
# type c otg control
CONFIG_HISENSE_TYPEC_OTG_CONTROL_FUNCTION=y
#
### Hisense TP configuriton
# CONFIG_CHIPONE_TDDI_TOUCHSCREEN is not set
# CONFIG_CHIPONE_TDDI_HAS_RESET_PIN is not set
# CONFIG_CHIPONE_TDDI_GESTURE is not set
# CONFIG_CHIPONE_TDDI_INCELL_CHIP is not set
# CONFIG_CHIPONE_TDDI_GLOVE is not set
# CONFIG_CHIPONE_TDDI_CHARGER_DETECT is not set
CONFIG_TOUCHSCREEN_FT5X06=y
# CONFIG_FT_INCELL_CHIP is not set
CONFIG_TOUCHSCREEN_FT5X06_GESTURE=y 
# CONFIG_TOUCHSCREEN_FT5X06_GESTURE_DRIVER is not set
# CONFIG_TOUCHSCREEN_FACE_DETECTION is not set
CONFIG_TOUCHSCREEN_FT5X06_GLOVE=y
CONFIG_TOUCHSCREEN_FT5X06_GFF_PANNEL=y
# CONFIG_TOUCHSCREEN_FT5X06_HALL is not set
# CONFIG_TOUCHSCREEN_FT5X06_PRAMUPDATE is not set
CONFIG_TOUCHSCREEN_FT5X06_APK_TEST=y
# CONFIG_TOUCHSCREEN_FT5X06_SUB is not set
# CONFIG_FT_SECURE_TOUCH is not set
CONFIG_TOUCHSCREEN_USB_CHECK=y
CONFIG_TOUCHSCREEN_FT5X06_FH=y
CONFIG_TOUCHSCREEN_WORK_MODE=y
CONFIG_TOUCHSCREEN_FT5X06_GET_PANNEL_ID=y
```

## arch/arm64/configs/l752_defconfig
```kconfig
#
# Hisense product Infomation
#
CONFIG_HISENSE_VENDOR_NAME="Hisense"
CONFIG_HISENSE_PRODUCT_NAME="l752"
CONFIG_SENSORS=y
CONFIG_SENSORS_SSC=y
#
# Hisense sensors device support
#
CONFIG_HS_SNS_ACC=y
CONFIG_HS_SNS_ADSP_ACC=y
CONFIG_HS_SNS_STEP=y
CONFIG_ACC_SENSOR_VENDOR="ICM"
CONFIG_ACC_SENSOR_TYPE="ICM40607"
CONFIG_HS_SNS_MAG=y
CONFIG_HS_SNS_ADSP_MAG=y
CONFIG_MAG_SENSOR_VENDOR="AKM"
CONFIG_MAG_SENSOR_TYPE="AK0991X"
CONFIG_HS_SNS_GYRO=y
CONFIG_HS_SNS_ADSP_GYRO=y
CONFIG_GYRO_SENSOR_VENDOR="ICM"
CONFIG_GYRO_SENSOR_TYPE="ICM40607"
CONFIG_HS_SNS_ALS_PS=y
CONFIG_HS_SNS_ADSP_ALSPS=y
CONFIG_ALSP_SENSOR_TYPE="STK"
CONFIG_ALSP_SENSOR_VENDOR="STK33562"
#
# Hisense chip efuse support
#
#
# Hisense charger function support
#
#CONFIG_HISENSE_BATTERY_THERM_NTC_10K is not set
CONFIG_HISENSE_SGM41512_CHARGER=y
#
# Hisense tp & backlight support
#
#CONFIG_BACKLIGHT_KTD3137 is not set
CONFIG_TOUCHSCREEN_SITRONIX_TS=y
CONFIG_TOUCHSCREEN_SITRONIX_TS_POWER_SUPPLY_EN=y
CONFIG_TOUCHSCREEN_SITRONIX_TS_GLOVE=y
CONFIG_TOUCHSCREEN_SITRONIX_TS_L762=y
CONFIG_TOUCHSCREEN_SITRONIX_TS_GESTURE=y
#
# Hisense nfc device support
#
CONFIG_HISENSE_NFC_PN547=y
CONFIG_MMC_FFU=y

CONFIG_BACKLIGHT_AW99703=y
#
# Hisense fingerprint device support
#
CONFIG_HS_FINGERPRINT=y
CONFIG_FINGERPRINT_SUNWAVE=y
CONFIG_FINGERPRINT_FPC_FPC1542=y
CONFIG_FINGERPRINT_VENDOR_CHECK=y
```

## arch/arm64/configs/p40_defconfig
```kconfig
#
# Hisense product Infomation
#
CONFIG_HISENSE_VENDOR_NAME="Hisense"
CONFIG_HISENSE_PRODUCT_NAME="p40"
CONFIG_PROJECTNAME_REPORT=y
CONFIG_SENSORS=y
CONFIG_SENSORS_SSC=y
#
# Hisense sensors device support
#
CONFIG_HS_SNS_ACC=y
CONFIG_HS_SNS_ADSP_ACC=y
CONFIG_HS_SNS_STEP=y
CONFIG_ACC_SENSOR_VENDOR="STK"
CONFIG_ACC_SENSOR_TYPE="STK8XXX"
CONFIG_HS_SNS_MAG=y
CONFIG_HS_SNS_ADSP_MAG=y
CONFIG_MAG_SENSOR_VENDOR="AKM"
CONFIG_MAG_SENSOR_TYPE="AK0991X"
# CONFIG_HS_SNS_GYRO is not set
# CONFIG_HS_SNS_ADSP_GYRO is not set
CONFIG_HS_SNS_ALS_PS=y
CONFIG_HS_SNS_ADSP_ALSPS=y
CONFIG_ALSP_SENSOR_TYPE="STK"
CONFIG_ALSP_SENSOR_VENDOR="STK3X3X"
#
# Hisense TP device support
#
CONFIG_TOUCHSCREEN_FTS_SPI=y
CONFIG_TOUCHSCREEN_FTS_SPI_DIRECTORY="focaltech_spi"
CONFIG_TOUCHSCREEN_WORK_MODE=y
CONFIG_TOUCHSCREEN_FT8006P_SPI_FH=y
CONFIG_TOUCHSCREEN_FT8006P_SPI_GESTURE=y
CONFIG_TOUCHSCREEN_FT8006P_SPI_GLOVE=y
CONFIG_TOUCHSCREEN_FT8006P_FW_FOR_HNR552T is not set
CONFIG_TOUCHSCREEN_USB_CHECK=y
CONFIG_FT_INCELL_CHIP=y
CONFIG_TOUCHSCREEN_CHIPONE_TDDI=y
CONFIG_TOUCHSCREEN_CHIPONE_TDDI_GESTURE=y
CONFIG_TOUCHSCREEN_CHIPONE_TDDI_GLOVE=y
CONFIG_TOUCHSCREEN_CHIPONE_TDDI_INCELL_CHIP=y
#
# Hisense backlight device support
#
CONFIG_BACKLIGHT_KTD3137=y
#
# Hisense usb device support
#
CONFIG_HISENSE_GPIO_TRIG_OTG=y
#
# Hisense fingerprint device support
#
CONFIG_HS_FINGERPRINT=y
CONFIG_FINGERPRINT_CHIPONE=y
CONFIG_FP_REPORT_WAKEUP_KEY=y
#
# Hisense fuse support
#
CONFIG_QCOM_CHIP_EFUSE=y
```

## arch/arm64/configs/upad1_defconfig
```kconfig
#
# Hisense product Infomation
#
CONFIG_HISENSE_VENDOR_NAME="Hisense"
CONFIG_HISENSE_PRODUCT_NAME="upad1"
CONFIG_PROJECTNAME_REPORT=y
CONFIG_SENSORS=y
CONFIG_SENSORS_SSC=y
#
# Hisense sensors device support
#
CONFIG_HS_SNS_ACC=y
CONFIG_HS_SNS_ADSP_ACC=y
CONFIG_ACC_SENSOR_VENDOR="KXTJ"
CONFIG_ACC_SENSOR_TYPE="KXTJ3"
CONFIG_HS_SNS_STEP=y
# CONFIG_HS_SNS_MAG is not set
# CONFIG_HS_SNS_ADSP_MAG is not set
# CONFIG_HS_SNS_GYRO is not set
# CONFIG_HS_SNS_ADSP_GYRO is not set
CONFIG_HS_SNS_ALS_PS=y
CONFIG_HS_SNS_ADSP_ALSPS=y
CONFIG_ALSP_SENSOR_TYPE="CM"
CONFIG_ALSP_SENSOR_VENDOR="CM36781"

CONFIG_HS_SNS_AP_ALS_PS=y
CONFIG_HS_SNS_CM36781=y
CONFIG_HS_SNS_CM36781_USE_VDD_EN_GPIO=y
CONFIG_HS_SNS_HALL=y
#
# Hisense TP device support
#
CONFIG_TOUCHSCREEN_FT5726=y
CONFIG_TOUCHSCREEN_FT5726_APK_TEST=y
CONFIG_TOUCHSCREEN_USB_CHECK=y
CONFIG_TOUCHSCREEN_FT5726_FH=y
#
# Hisense backlight device support
#
CONFIG_BACKLIGHT_KTZ8866=y
#
# Hisense usb device support
#
# CONFIG_HISENSE_GPIO_TRIG_OTG is not set
#
# Hisense typec pogo pen support
#
CONFIG_HISENSE_TYPEC_POGO_PEN=y
#
# Hisense ukl safe mode support
#
CONFIG_HISENSE_UKL_SAFE_MODE_FUNCTION=y
#
# Hisense fingerprint device support
#
CONFIG_HS_FINGERPRINT=y
CONFIG_FINGERPRINT_CHIPONE=y
CONFIG_FP_REPORT_WAKEUP_KEY=y
#
# Hisense fuse support
#
CONFIG_QCOM_CHIP_EFUSE=y
```

## drivers/input/touchscreen/chipone_tddi/Kconfig
```kconfig
# SPDX-License-Identifier: GPL-2.0-only
#
# STMicroelectronics touchscreen driver configuration
#

config TOUCHSCREEN_CHIPONE_TDDI_GESTURE
       bool "chipone touchscreens gesture function"
       depends on TOUCHSCREEN_CHIPONE_TDDI
       default n
       help
         Say Y here if you need a chipone touchscreen gesture function.
	 else say N

config TOUCHSCREEN_CHIPONE_TDDI_GLOVE
       bool "chipone touchscreens glove function"
       depends on TOUCHSCREEN_CHIPONE_TDDI
       default n
       help
         Say Y here if you need a chipone touchscreen glove function.
	 else say N

config TOUCHSCREEN_CHIPONE_TDDI_INCELL_CHIP
       bool "Chipone incell touchscreens support."
       depends on TOUCHSCREEN_CHIPONE_TDDI
       help
         Say Y here if you need a chipone incell touchscreen function.
	 else say N
```

## drivers/input/touchscreen/focaltech_ft5726/Kconfig
```kconfig
#
# Focaltech Touchscreen driver configuration
#

config FT_INCELL_CHIP
	bool "FocalTech touchscreens incell chip support."
	depends on TOUCHSCREEN_FT5726
	help
	  Say Y here if you need a FT5726 touchscreen FH function.
	  else say N

config TOUCHSCREEN_FT5726_IRQ_WAKE
	bool "FocalTech touchscreens dont register .pm"
	depends on TOUCHSCREEN_FT5726
	help
	  Say Y here if you need a FT5726 touchscreen dont register .pm.
	  else say N

config TOUCHSCREEN_FT5726_FH
	bool "FocalTech touchscreens FH support."
	depends on TOUCHSCREEN_USB_CHECK && TOUCHSCREEN_FT5726
	help
	  Say Y here if you need a FT5726 touchscreen FH function.
	  else say N

config TOUCHSCREEN_FT5726_GESTURE
	bool "FocalTech touchscreens gesture function"
	depends on TOUCHSCREEN_FT5726
	help
	  Say Y here if you need a FT5726 touchscreen gesture function.
	  else say N

config TOUCHSCREEN_FT5726_GESTURE_DRIVER
	bool "FocalTech touchscreens gesture function realized in driver"
	depends on TOUCHSCREEN_FT5726_GESTURE
	help
	  Say Y here if you need a FT5726 touchscreen gesture function in driver.
	  else say N
	 
config TOUCHSCREEN_FACE_DETECTION
	bool "FocalTech touchscreens face detection function realized in driver"
	depends on TOUCHSCREEN_FT5726
	help
	  Say Y here if you need a FT5726 touchscreen gesture function in driver.
	  else say N

config TOUCHSCREEN_FT5726_GLOVE
	bool "FocalTech touchscreens glove mode function realized in driver"
	depends on TOUCHSCREEN_FT5726
	help
	  Say Y here if you need a FT5726 glove mode in driver.
	  else say N

config TOUCHSCREEN_FT5726_HALL
	bool "FocalTech touchscreens hall mode function realized in driver"
	depends on TOUCHSCREEN_FT5726
	help
	  Say Y here if you need a FT5726 hall mode in driver.
	  else say N

config TOUCHSCREEN_FT5726_PRAMUPDATE
	bool "FocalTech touchscreens ft8719 pramboot data in driver"
	depends on TOUCHSCREEN_FT5726
	default n
	help
	  Say Y here if you need a ft8719 pramboot data in driver.
	  else say N

config TOUCHSCREEN_FT5726_APK_TEST
	bool "FocalTech touchscreens apk test function realized in driver"
	depends on TOUCHSCREEN_FT5726
	help
	  Say Y here if you need a FT5726 apk test in driver.
	  else say N

config TOUCHSCREEN_FT5726_SUB
	bool "FocalTech touchscreens sub function realized in driver"
	depends on TOUCHSCREEN_FT5726
	help
	  Say Y here if you need a FT5726 as sub TP in driver.
	  else say N

config TOUCHSCREEN_FT5726_PSENSOR
	tristate "FocalTech proximity feature support"
	depends on TOUCHSCREEN_FT5726 && SENSORS
	help
	  Say Y here if you want to support FT5726's proximity
	  feature.

	  If unsure, say N.
```

## drivers/input/touchscreen/focaltech_spi/Kconfig
```kconfig
#
# Focaltech Touchscreen driver configuration
#

config TOUCHSCREEN_FTS_SPI
	tristate "Focaltech Touchscreen test"
	depends on SPI_MASTER
	help
	  Say Y here if you have Focaltech touch panel.

	  If unsure, say N.

	  To compile this driver as a module, choose M here: the
	  module will be called focal_spi_ts.

config TOUCHSCREEN_FTS_SPI_DIRECTORY
	string "Focaltech ts directory name"
	default "focaltech_spi"
	depends on TOUCHSCREEN_FTS_SPI

config FT_INCELL_CHIP
	bool "FocalTech incell touchscreens support."
	depends on TOUCHSCREEN_FTS_SPI
	help
	  Say Y here if you use a incell focaltech touchscreen.
	  else say N
config TOUCHSCREEN_FT8006P_FW_FOR_HNR552T
	bool "FocalTech touchscreens FW for HNR552T&HNR551T."
	depends on TOUCHSCREEN_FTS_SPI
	help
	  Say Y here if you use FW for HNR552T&HNR551T project.
	  else say N

config TOUCHSCREEN_FT8006P_SPI_FH
	bool "FocalTech touchscreens FH support."
	depends on TOUCHSCREEN_FTS_SPI
	help
	  Say Y here if you need a ft5X06 touchscreen FH function.
	  else say N

config TOUCHSCREEN_FT8006P_SPI_GESTURE
	bool "FocalTech touchscreens gesture function"
	depends on TOUCHSCREEN_FTS_SPI
	help
	  Say Y here if you need a ft8006p touchscreen gesture function.
	  else say N

config TOUCHSCREEN_FT8006P_SPI_GLOVE
	bool "FocalTech touchscreens glove mode function realized in driver"
	depends on TOUCHSCREEN_FTS_SPI
	help
	  Say Y here if you need a ft8xxx glove mode in driver.
	  else say N
```

## drivers/input/touchscreen/sitronix_touch/Kconfig
```kconfig
# SPDX-License-Identifier: GPL-2.0-only
#
# STMicroelectronics touchscreen driver configuration
#

config TOUCHSCREEN_SITRONIX_TS
	tristate "sitronix_ts Touchscreen test"
	depends on I2C
	help
	  Say Y here if you have sitronix_ts touch panel.

	  If unsure, say N.

	  To compile this driver as a module, choose M here: the
	  module will be called focal_spi_ts.
config TOUCHSCREEN_SITRONIX_TS_POWER_SUPPLY_EN
	bool "sitronix_ts itouchscreens support."
	depends on TOUCHSCREEN_SITRONIX_TS
	help
	  Say Y here if you use a power supply sitronix_ts touchscreen.
	  else say N
config TOUCHSCREEN_SITRONIX_TS_GLOVE
	bool "sitronix_ts itouchscreens support."
	depends on TOUCHSCREEN_SITRONIX_TS
	help
	  Say Y here if you use a power supply sitronix_ts touchscreen.
	  else say N
config TOUCHSCREEN_SITRONIX_TS_L762
	bool "sitronix_ts itouchscreens support."
	depends on TOUCHSCREEN_SITRONIX_TS
	help
	  Say Y here if you use l762 fw supply sitronix_ts touchscreen.
	  else say N
config TOUCHSCREEN_SITRONIX_TS_GESTURE
	bool "sitronix_ts itouchscreens support."
	depends on TOUCHSCREEN_SITRONIX_TS
	help
	  Say Y here if you use gesture supply sitronix_ts touchscreen.
	  else say N
```

## drivers/sensors/HS_SNS_DRV/Kconfig
```kconfig
#
# SPRD Sensor Hub drivers configuration
#

menu "Hisense sensors device support"
	depends on SENSORS

config HS_SNS_AP_ALS_PS
	tristate "Hisense sensors device support"
	help
	  Support AP ALSPS Sensor Feature

	  Say Y here to build support for AP alsps.
	  To compile this driver as a module, choose M here

config HS_SNS_CM36781
	tristate "Capella cm36781 device support"
	depends on HS_SNS_AP_ALS_PS
	help
          Support capella cm36781 ALSPS Sensor Feature

          Say Y here to build support for cm36781 alsps.
          To compile this driver as a module, choose M here

config HS_SNS_CM36781_USE_VDD_EN_GPIO
	bool "Capella cm36781 device support USE VDD EN GPIO"
	depends on HS_SNS_CM36781
	help
	  Say Y here if you need a Capella cm36781 device support USE VDD EN GPIO.
	  else say N

config HS_SNS_HALL
	bool "Provide Hall Device Support"
	default n
	depends on HS_SNS_AP_ALS_PS
	help
	  Say Y here, select hall chip .

endmenu
```

## drivers/soc/hisense/base/Kconfig
```kconfig
comment "Hisense product Infomation"
config MACH_HISENSE_SMARTPHONE
	bool "HISENSE SMARTPHONE"
	default n
	help
	  Support for the hisense samrtphone board.

config HISENSE_BOOT_FLOW
	bool "Hisense boot flow"
	default n
	help
	  Provide a methed for panic handle.

config HISENSE_VENDOR_NAME
	depends on MACH_HISENSE_SMARTPHONE
	string "Hisense vendor info"
	default ""
	help
	  The vendor name of product.

config HISENSE_PRODUCT_NAME
	depends on MACH_HISENSE_SMARTPHONE
	string "Hisense product info"
	default ""
	help
	  The product name.

config HISENSE_PLATFORM_NAME
	depends on MACH_HISENSE_SMARTPHONE
	string "Hisense platform info"
	default ""
	help
	  The platform name.

config HISENSE_BOOT_INFO
	bool "Hisense Boot information"
	depends on MACH_HISENSE_SMARTPHONE
	default y
	help
	  The information of booting system.

config HISENSE_DEBUG_CTRL
	bool "Hisense debug method"
	depends on MACH_HISENSE_SMARTPHONE
	default y
	help
	  Say Y when you need debug your device.

config HIDE_COMPILE_HOST
	bool "set LINUX_COMPILE_HOST to a fixed string"
	depends on MACH_HISENSE_SMARTPHONE
	default n
	help
	  To hide the real compile host name, if unsure, say N.

config DONOT_USE_SETUP
	bool "do not use __setup macro get bootmode"
	depends on MACH_HISENSE_SMARTPHONE
	default n
	help
	  If say N, use __setup macro get bootmode.

config HISENSE_SYSTEM_32BIT
	bool "Hisense 32bit system"
	depends on MACH_HISENSE_SMARTPHONE
	default n
	help
	  The feature of 32bit system.
```

## drivers/soc/hisense/mm/Kconfig
```kconfig
config USELESS_RES_RECLAIM
	bool "reclaim the useless resource of the process"
	default n
	depends on MACH_HISENSE_SMARTPHONE
	help
	  Enable it to support reclaim useless resource by command:
	  "echo useless > /proc/PID/reclaim"

config HISENSE_SMART_SHRINK
	bool "smart shrink memory when device running"
	default n
	depends on HISENSE_SHRINK_MEMORY
	help
	  Enable it to support smart shrink memory

config HISENSE_SWAPPINESS_OPT
	bool "optimize swap memory"
	default n
	depends on MACH_HISENSE_SMARTPHONE
	help
	  Enable it to swap anon pages to swap
```
